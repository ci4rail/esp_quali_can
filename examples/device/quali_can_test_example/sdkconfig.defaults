## examples/device/quali_can_test_example/sdkconfig.defaults
```kconfig
CONFIG_IDF_TARGET="esp32s2"
CONFIG_TINYUSB=y
CONFIG_TINYUSB_NET_ENABLED=y
CONFIG_FREERTOS_HZ=1000
CONFIG_BOOTLOADER_APP_ROLLBACK_ENABLE=y
CONFIG_PARTITION_TABLE_TWO_OTA=y
CONFIG_ESPTOOLPY_FLASHSIZE_4MB=y
CONFIG_ESP_TASK_WDT_PANIC=y
CONFIG_ESP_TASK_WDT_TIMEOUT_S=6
CONFIG_IO4EDGE_CDC_ECM=y
CONFIG_FREERTOS_MAX_TASK_NAME_LEN=64
CONFIG_LWIP_MAX_LISTENING_TCP=16
CONFIG_LWIP_MAX_SOCKETS=16
CONFIG_COMPILER_OPTIMIZATION_PERF=y
CONFIG_ESPTOOLPY_FLASHMODE_QIO=y
CONFIG_IO4EDGE_HW_INV_FLASH=y
```
